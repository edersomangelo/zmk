## app/boards/shields/slackboy_sofle/Kconfig.shield
```kconfig
# Copyright (c) 2020 Ryan Cross
# SPDX-License-Identifier: MIT

config SHIELD_SLACKBOY_SOFLE_LEFT
    def_bool $(shields_list_contains,slackboy_sofle_left)

config SHIELD_SLACKBOY_SOFLE_RIGHT
    def_bool $(shields_list_contains,slackboy_sofle_right)
```
